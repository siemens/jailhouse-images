## wic/orangepi-zero.wks
```
#
# Jailhouse, a Linux-based partitioning hypervisor
#
# Copyright (c) Siemens AG, 2018
#
# Authors:
#  Jan Kiszka <jan.kiszka@siemens.com>
#
# SPDX-License-Identifier: MIT
#

part u-boot --source rawcopy --sourceparams "file=/usr/lib/u-boot/orangepi_zero/u-boot-sunxi-with-spl.bin" --no-table --align 8

part / --source rootfs-u-boot --ondisk mmcblk0 --fstype ext4 --mkfs-extraopts "-T default" --label platform --align 1024 --sourceparams "no_initrd=yes,script_prepend=setenv fdt_high 0xffffffff"

bootloader --append "mem=128M vmalloc=512M"
```

## wic/pine64-plus.wks
```
#
# Jailhouse, a Linux-based partitioning hypervisor
#
# Copyright (c) Vijai Kumar K, 2020
#
# Authors:
#  Vijai Kumar K <vijaikumar.kanagarajan@gmail.com>
#
# SPDX-License-Identifier: MIT
#

part u-boot --source rawcopy --sourceparams "file=/usr/lib/u-boot/pine64-plus/u-boot-sunxi-with-spl.bin" --no-table --align 8

part / --source rootfs-u-boot --ondisk mmcblk0 --fstype ext4 --label platform --align 1024 --active --sourceparams "no_initrd=yes"

bootloader --append "rootwait mem=1792M"
```

## wic/rpi4.wks
```
#
# Jailhouse, a Linux-based partitioning hypervisor
#
# Copyright (c) Siemens AG, 2019
#
# Authors:
#  Jan Kiszka <jan.kiszka@siemens.com>
#
# SPDX-License-Identifier: MIT
#

part --source bootimg-partition --ondisk mmcblk0 --fstype vfat --label boot --align 1 --size 32 --overhead-factor 1 --extra-space 0

part / --source rootfs --ondisk mmcblk0 --fstype ext4 --label platform --align 1024 --active

# silence wic
bootloader
```

## wic/ultra96.wks
```
#
# Jailhouse, a Linux-based partitioning hypervisor
#
# Copyright (c) Siemens AG, 2019
#
# Authors:
#  Jan Kiszka <jan.kiszka@siemens.com>
#
# SPDX-License-Identifier: MIT
#

part --source bootimg-partition --ondisk mmcblk0 --fstype vfat --label boot --align 1 --size 16 --overhead-factor 1 --extra-space 0

part / --source rootfs-u-boot --ondisk mmcblk0 --fstype ext4 --label platform --align 1024 --active

bootloader --append "mem=1820M"
```
