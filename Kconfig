## Kconfig
```kconfig
mainmenu "Jailhouse Reference Images"

config KAS_INCLUDE_MAIN
	string
	default "kas.yml"

config KAS_BUILD_SYSTEM
	string
	default "isar"

comment "Targets to be built"

config TARGET_QEMU_AMD64
	bool "QEMU/KVM Intel-x86 virtual target"
	default y

config KAS_TARGET_QEMU_AMD64
	string
	depends on TARGET_QEMU_AMD64
	default "mc:qemu-amd64-jailhouse-demo:demo-image"


config TARGET_QEMU_ARM
	bool "QEMU ARM virtual target"

config KAS_TARGET_QEMU_ARM
	string
	depends on TARGET_QEMU_ARM
	default "mc:qemu-arm-jailhouse-demo:demo-image"


config TARGET_QEMU_ARM64
	bool "QEMU ARM64 virtual target"

config KAS_TARGET_QEMU_ARM64
	string
	depends on TARGET_QEMU_ARM64
	default "mc:qemu-arm64-jailhouse-demo:demo-image"


config TARGET_ORANGEPI_ZERO
	bool "Orange Pi Zero (256 MB edition)"

config KAS_TARGET_ORANGEPI_ZERO
	string
	depends on TARGET_ORANGEPI_ZERO
	default "mc:orangepi-zero-jailhouse-demo:demo-image"


config TARGET_NUC6CAY
	bool "Intel NUC (NUC6CAY, 8 GB RAM)"

config KAS_TARGET_NUC6CAY
	string
	depends on TARGET_NUC6CAY
	default "mc:nuc6cay-jailhouse-demo:demo-image"


config TARGET_Q7_AL_E3940
	bool "MSC Q7-AL-E3940-24N0211I"

config KAS_TARGET_Q7_AL_E3940
	string
	depends on TARGET_Q7_AL_E3940
	default "mc:q7-al-e3940-jailhouse-demo:demo-image"


config TARGET_ESPRESSOBIN
	bool "Marvell ESPRESSObin (1 GB edition)"

config KAS_TARGET_ESPRESSOBIN
	string
	depends on TARGET_ESPRESSOBIN
	default "mc:espressobin-jailhouse-demo:demo-image"


config TARGET_MACCHIATOBIN
	bool "Marvell MACCHIATObin"

config KAS_TARGET_MACCHIATOBIN
	string
	depends on TARGET_MACCHIATOBIN
	default "mc:macchiatobin-jailhouse-demo:demo-image"


config TARGET_HIKEY620
	bool "LeMaker HiKey (Kirin 620 SoC, 2 GB edition)"

config KAS_TARGET_HIKEY620
	string
	depends on TARGET_HIKEY620
	default "mc:hikey620-jailhouse-demo:demo-image"


config TARGET_ULTRA96_V1
	bool "Avnet Ultra96 v1"

config KAS_TARGET_ULTRA96_V1
	string
	depends on TARGET_ULTRA96_V1
	default "mc:ultra96-v1-jailhouse-demo:demo-image"


config TARGET_ULTRA96_V2
	bool "Avnet Ultra96 v2"

config KAS_TARGET_ULTRA96_V2
	string
	depends on TARGET_ULTRA96_V2
	default "mc:ultra96-v2-jailhouse-demo:demo-image"


config TARGET_RPI4
	bool "Raspberry Pi 4 (1-8 GB editions)"

config KAS_TARGET_RPI4
	string
	depends on TARGET_RPI4
	default "mc:rpi4-jailhouse-demo:demo-image"


config TARGET_PINE64_PLUS
	bool "Pine64+ (Allwinner A64, 2 GB edition)"

config KAS_TARGET_PINE64_PLUS
	string
	depends on TARGET_PINE64_PLUS
	default "mc:pine64-plus-jailhouse-demo:demo-image"


comment "Image options"

config RT
	bool "Use Preempt RT kernel"
	help
	  Use Preempt RT kernel for root and non-root cell. Typical RT tests
	  are included in the image.

config KAS_INCLUDE_RT
	string
	depends on RT
	default "opt-rt.yml"


config LATEST
	bool "Build latest Jailhouse version"
	help
	  Build Jailhouse from 'next' branch in git, rather than from the
	  last release.

config KAS_INCLUDE_LATEST
	string
	depends on LATEST
	default "opt-latest.yml"
```

## conf/distro/jailhouse-demo.conf
```bitbake
#
# Jailhouse, a Linux-based partitioning hypervisor
#
# Copyright (c) Siemens AG, 2018-2019
#
# Authors:
#  Jan Kiszka <jan.kiszka@siemens.com>
#
# SPDX-License-Identifier: MIT
#

require conf/distro/debian-bullseye.conf

KERNEL_NAME ?= "jailhouse"

WKS_FILE ?= "${MACHINE}.wks"

PREFERRED_VERSION_jailhouse-${KERNEL_NAME} ?= "0.9999-next"

PREFERRED_PROVIDER_trusted-firmware-a-${MACHINE} ?= "trusted-firmware-a-${MACHINE}"
PREFERRED_PROVIDER_u-boot-${MACHINE} ?= "u-boot-${MACHINE}"

USERS += "root"
# 'root'
USER_root[password] = "oC3wEGl799tZU"
```

## conf/layer.conf
```bitbake
#
# Jailhouse, a Linux-based partitioning hypervisor
#
# Copyright (c) Siemens AG, 2018
#
# Authors:
#  Jan Kiszka <jan.kiszka@siemens.com>
#
# SPDX-License-Identifier: MIT
#

BBPATH .= ":${LAYERDIR}"

BBFILES += "${LAYERDIR}/recipes-*/*/*.bb \
        ${LAYERDIR}/recipes-*/*/*.bbappend"

BBFILE_COLLECTIONS += "jailhouse"
BBFILE_PATTERN_jailhouse = "^${LAYERDIR}/"
BBFILE_PRIORITY_jailhouse = "6"

LAYERSERIES_COMPAT_jailhouse = "next"

LAYERDIR_jailhouse = "${LAYERDIR}"
```

## conf/machine/hikey620.conf
```bitbake
#
# Jailhouse, a Linux-based partitioning hypervisor
#
# Copyright (c) Siemens AG, 2018
#
# Authors:
#  Jan Kiszka <jan.kiszka@siemens.com>
#
# SPDX-License-Identifier: MIT
#

DISTRO_ARCH = "arm64"

IMAGE_TYPE = "wic-img"
IMAGER_INSTALL += "${GRUB_BOOTLOADER_INSTALL}"

IMAGE_PREINSTALL_append = " firmware-ti-connectivity"
```

## conf/machine/ipc127e.conf
```bitbake
#
# Jailhouse, a Linux-based partitioning hypervisor
#
# Copyright (c) Siemens AG, 2020
#
# Authors:
#  Jan Kiszka <jan.kiszka@siemens.com>
#
# SPDX-License-Identifier: MIT
#

DISTRO_ARCH = "amd64"

IMAGE_TYPE = "wic-img"
IMAGER_INSTALL += "${GRUB_BOOTLOADER_INSTALL}"
```

## conf/machine/macchiatobin.conf
```bitbake
#
# Jailhouse, a Linux-based partitioning hypervisor
#
# Copyright (c) Siemens AG, 2018
#
# Authors:
#  Jan Kiszka <jan.kiszka@siemens.com>
#
# SPDX-License-Identifier: MIT
#

DISTRO_ARCH = "arm64"

IMAGE_TYPE = "wic-img"
IMAGER_INSTALL += "trusted-firmware-a-macchiatobin"
IMAGER_BUILD_DEPS += "trusted-firmware-a-macchiatobin"

IMAGE_INSTALL += "u-boot-script"
```

## conf/machine/orangepi-zero.conf
```bitbake
#
# Jailhouse, a Linux-based partitioning hypervisor
#
# Copyright (c) Siemens AG, 2018
#
# Authors:
#  Jan Kiszka <jan.kiszka@siemens.com>
#
# SPDX-License-Identifier: MIT
#

DISTRO_ARCH = "armhf"

IMAGE_TYPE = "wic-img"
IMAGER_INSTALL += "u-boot-sunxi"

IMAGE_INSTALL += "u-boot-script xradio-${KERNEL_NAME}"
```

## conf/machine/pine64-plus.conf
```bitbake
#
# Jailhouse, a Linux-based partitioning hypervisor
#
# Copyright (c) Vijai Kumar K, 2020
#
# Authors:
#  Vijai Kumar K <vijaikumar.kanagarajan@gmail.com>
#
# SPDX-License-Identifier: MIT
#

DISTRO_ARCH = "arm64"

IMAGE_TYPE = "wic-img"
IMAGER_INSTALL += "u-boot-pine64-plus"
IMAGER_BUILD_DEPS += "u-boot-pine64-plus"

IMAGE_INSTALL += "u-boot-script"
```

## conf/machine/qemu-arm.conf
```bitbake
#
# Jailhouse, a Linux-based partitioning hypervisor
#
# Copyright (c) Siemens AG, 2020
#
# Authors:
#  Jan Kiszka <jan.kiszka@siemens.com>
#
# SPDX-License-Identifier: MIT
#

require qemu-machine.inc

DISTRO_ARCH = "armhf"
```

## conf/machine/qemu-arm64.conf
```bitbake
#
# Jailhouse, a Linux-based partitioning hypervisor
#
# Copyright (c) Siemens AG, 2018
#
# Authors:
#  Jan Kiszka <jan.kiszka@siemens.com>
#
# SPDX-License-Identifier: MIT
#

require qemu-machine.inc

DISTRO_ARCH = "arm64"
```

## conf/machine/qemu-machine.inc
```bitbake
#
# Jailhouse, a Linux-based partitioning hypervisor
#
# Copyright (c) Siemens AG, 2018
#
# Authors:
#  Jan Kiszka <jan.kiszka@siemens.com>
#
# SPDX-License-Identifier: MIT
#

IMAGE_TYPE = "ext4-img"

IMAGE_INSTALL_remove += "expand-on-first-boot"
ROOTFS_EXTRA = "1024"
```

## conf/machine/rpi4.conf
```bitbake
#
# Jailhouse, a Linux-based partitioning hypervisor
#
# Copyright (c) Siemens AG, 2019
#
# Authors:
#  Jan Kiszka <jan.kiszka@siemens.com>
#
# SPDX-License-Identifier: MIT
#

DISTRO_ARCH = "arm64"

IMAGE_TYPE = "wic-img"
IMAGER_BUILD_DEPS = "rpi-firmware trusted-firmware-a-rpi4 linux-image-${KERNEL_NAME}"
IMAGER_INSTALL += "${IMAGER_BUILD_DEPS}"

IMAGE_BOOT_FILES = " \
    /usr/lib/rpi-firmware/bootcode.bin;bootcode.bin \
    /usr/lib/rpi-firmware/cmdline.txt;cmdline.txt \
    /usr/lib/rpi-firmware/config.txt;config.txt \
    /usr/lib/rpi-firmware/fixup4.dat;fixup4.dat \
    /usr/lib/rpi-firmware/fixup4x.dat;fixup4x.dat \
    /usr/lib/rpi-firmware/start4.elf;start4.elf \
    /usr/lib/rpi-firmware/start4x.elf;start4x.elf \
    /usr/lib/rpi-firmware/overlays/*;overlays/ \
    /usr/lib/linux-image-*/broadcom/bcm2711-rpi-4-b.dtb \
    /usr/lib/linux-image-*/overlays/*;overlays/ \
    /usr/lib/trusted-firmware-a/rpi4/bl31.bin;bl31.bin \
    /vmlinuz;kernel8.img \
    "

KERNEL_NAME ?= "jailhouse-rpi"

IMAGE_PREINSTALL_append = " firmware-brcm80211"
IMAGE_INSTALL_append = " rpi-firmware-brcm80211"
```

## conf/machine/ultra96-v2.conf
```bitbake
#
# Jailhouse, a Linux-based partitioning hypervisor
#
# Copyright (c) Siemens AG, 2019-2020
#
# Authors:
#  Jan Kiszka <jan.kiszka@siemens.com>
#
# SPDX-License-Identifier: MIT
#

require ultra96.inc

ULTRA96_VERSION = "2"

IMAGE_INSTALL += "wilc-${KERNEL_NAME}"
```

## conf/machine/ultra96.conf
```bitbake
#
# Jailhouse, a Linux-based partitioning hypervisor
#
# Copyright (c) Siemens AG, 2019
#
# Authors:
#  Jan Kiszka <jan.kiszka@siemens.com>
#
# SPDX-License-Identifier: MIT
#

DISTRO_ARCH = "arm64"

IMAGE_TYPE = "wic-img"
IMAGER_INSTALL += "u-boot-ultra96"
IMAGER_BUILD_DEPS += "u-boot-ultra96"
IMAGE_INSTALL_append = " u-boot-script"

IMAGE_BOOT_FILES = "/usr/lib/u-boot/ultra96/boot.bin;boot.bin"

PREFERRED_PROVIDER_u-boot-ultra96 = "u-boot-ultra96"

IMAGE_PREINSTALL_append = " firmware-ti-connectivity"
```

## conf/machine/ultra96.inc
```bitbake
#
# Jailhouse, a Linux-based partitioning hypervisor
#
# Copyright (c) Siemens AG, 2019-2020
#
# Authors:
#  Jan Kiszka <jan.kiszka@siemens.com>
#
# SPDX-License-Identifier: MIT
#

DISTRO_ARCH = "arm64"

IMAGE_TYPE = "wic-img"
WKS_FILE = "ultra96.wks"
IMAGER_INSTALL += "u-boot-ultra96-v${ULTRA96_VERSION}"
IMAGER_BUILD_DEPS += "u-boot-ultra96-v${ULTRA96_VERSION}"
IMAGE_INSTALL_append = " u-boot-script"

IMAGE_BOOT_FILES = "/usr/lib/u-boot/ultra96-v${ULTRA96_VERSION}/boot.bin;boot.bin"

IMAGE_PREINSTALL_append = " firmware-ti-connectivity"
```

## scripts/lib/wic/canned-wks/espressobin.wks
```
#
# Jailhouse, a Linux-based partitioning hypervisor
#
# Copyright (c) Siemens AG, 2018
#
# Authors:
#  Jan Kiszka <jan.kiszka@siemens.com>
#
# SPDX-License-Identifier: MIT
#

part / --source rootfs --ondisk mmcblk0 --fstype ext4 --label platform --align 1024
```

## scripts/lib/wic/canned-wks/macchiatobin.wks
```
#
# Jailhouse, a Linux-based partitioning hypervisor
#
# Copyright (c) Siemens AG, 2018
#
# Authors:
#  Jan Kiszka <jan.kiszka@siemens.com>
#
# SPDX-License-Identifier: MIT
#

part u-boot --source rawcopy --sourceparams "file=/usr/lib/u-boot/macchiatobin/flash-image.bin" --no-table --align 2048 --size 2M

part / --source rootfs --ondisk mmcblk1 --fstype ext4 --label platform --active --align 1024
```

## scripts/lib/wic/canned-wks/nuc6cay.wks
```
#
# Jailhouse, a Linux-based partitioning hypervisor
#
# Copyright (c) Siemens AG, 2018
#
# Authors:
#  Jan Kiszka <jan.kiszka@siemens.com>
#
# SPDX-License-Identifier: MIT
#

part /boot --source bootimg-efi-isar --sourceparams "loader=grub-efi" --ondisk sda --label efi --part-type EF00 --align 1024

part / --source rootfs --ondisk sda --fstype ext4 --label platform --align 1024 --use-uuid

bootloader --ptable gpt --timeout 3 --append "rootwait intel_iommu=off memmap=82M\$0x3a000000"
```

## scripts/lib/wic/canned-wks/orangepi-zero.wks
```
#
# Jailhouse, a Linux-based partitioning hypervisor
#
# Copyright (c) Siemens AG, 2018
#
# Authors:
#  Jan Kiszka <jan.kiszka@siemens.com>
#
# SPDX-License-Identifier: MIT
#

part u-boot --source rawcopy --sourceparams "file=/usr/lib/u-boot/orangepi_zero/u-boot-sunxi-with-spl.bin" --no-table --align 8

part / --source rootfs --ondisk mmcblk0 --fstype ext4 --label platform --align 1024
```

## wic/espressobin.wks
```
#
# Jailhouse, a Linux-based partitioning hypervisor
#
# Copyright (c) Siemens AG, 2018
#
# Authors:
#  Jan Kiszka <jan.kiszka@siemens.com>
#
# SPDX-License-Identifier: MIT
#

part / --source rootfs-u-boot --ondisk mmcblk0 --fstype ext4 --label platform --align 1024 --sourceparams "no_initrd=yes,script_prepend=setenv devtype mmc;setenv devnum 0;setenv distro_bootpart 1;setenv fdt_addr_r 0x4f00000;setenv fdtfile marvell/armada-3720-espressobin.dtb;setenv kernel_addr_r 0x5000000"

bootloader --append "rw rootwait mem=768M"
```

## wic/hikey620.wks
```
#
# Jailhouse, a Linux-based partitioning hypervisor
#
# Copyright (c) Siemens AG, 2018
#
# Authors:
#  Jan Kiszka <jan.kiszka@siemens.com>
#
# SPDX-License-Identifier: MIT
#

part /boot/efi --source bootimg-efi-isar --sourceparams "loader=grub-efi" --label efi --part-type EF00 --align 1024 --use-uuid

part / --source rootfs --fstype ext4 --mkfs-extraopts "-T default" --label platform --align 1024 --use-uuid

bootloader --ptable gpt --timeout 3 --append "mem=1820M"
```

## wic/ipc127e.wks
```
#
# Jailhouse, a Linux-based partitioning hypervisor
#
# Copyright (c) Siemens AG, 2020
#
# Authors:
#  Jan Kiszka <jan.kiszka@siemens.com>
#
# SPDX-License-Identifier: MIT
#

part /boot/efi --source bootimg-efi-isar --sourceparams "loader=grub-efi" --label efi --part-type EF00 --align 1024 --use-uuid

part / --source rootfs --fstype ext4 --mkfs-extraopts "-T default" --label platform --align 1024 --use-uuid

bootloader --ptable gpt --timeout 3 --append "intel_iommu=off memmap=82M\$0x3a000000"
```

## wic/macchiatobin.wks
```
#
# Jailhouse, a Linux-based partitioning hypervisor
#
# Copyright (c) Siemens AG, 2018
#
# Authors:
#  Jan Kiszka <jan.kiszka@siemens.com>
#
# SPDX-License-Identifier: MIT
#

part u-boot --source rawcopy --sourceparams "file=/usr/lib/trusted-firmware-a/macchiatobin/flash-image.bin" --no-table --align 2048 --size 2M

part / --source rootfs-u-boot --ondisk mmcblk1 --fstype ext4 --mkfs-extraopts "-T default" --label platform --active --align 1024 --sourceparams "no_initrd=yes"

bootloader --append "rw rootwait cma=32M mem=3840M"
```
