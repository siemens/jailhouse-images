/*
 * Jailhouse, a Linux-based partitioning hypervisor
 *
 * Copyright (c) Siemens AG, 2021-2022
 *
 * Authors:
 *  Jan Kiszka <jan.kiszka@siemens.com>
 *
 * SPDX-License-Identifier: MIT
 */

/dts-v1/;
/plugin/;
/ {
	compatible = "brcm,bcm2835";

	fragment@0 {
		target-path = "/";
		__overlay__ {
			aliases {
				/* Needed to enable UART1 for use by TF-A */
				uart1 = "/soc/serial@7e215040";

				/* Ensure stable /dev/mmcblk0 assignment */
				mmc0 = "/emmc2bus/mmc@7e340000";
				mmc1 = "/soc/mmc@7e300000";
			};
		};
	};
};
